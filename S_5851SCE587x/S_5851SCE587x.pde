// SCE587x
// OSRAM SCE587x
// 
#include <Wire.h>
// #include <WString.h>
// #define maxLength 30
#include<stdio.h>

#define S5851_ADDR 0x48

//String nameString = String(maxLength);       // allocate a new String
//int characterPosition = 8;

int LOAD = 2;
int SDA  = 3;
int SCK  = 4;
int RST  = 5;

unsigned char pos=0;
// unsigned char i = 0;
int ret;
int intTemp = 0;
int StoredData = 0;

//byte opcode;
byte clumnData[7];
byte CHAR_SET[]={
//ROW0  ROW1  ROW2  ROW3  ROW4  ROW5  ROW6  ----     Hex  Dec char
  0x02, 0x06, 0x0E, 0x1E, 0x0E, 0x06, 0x02, 0x00, // 0x00   0 left triangle
  0x04, 0x00, 0x04, 0x08, 0x11, 0x11, 0x0E, 0x00, // 0x01   1 ¿
  0x1F, 0x00, 0x11, 0x0A, 0x04, 0x0A, 0x11, 0x00, // 0x02   2 x bar
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  0x0A, 0x15, 0x0A, 0x15, 0x0A, 0x15, 0x0A, 0x00  // 0x7F 127 CheckerPattern
};

void setup()
{
  pinMode(LOAD,OUTPUT);
  pinMode(SDA,OUTPUT);
  pinMode(SCK,OUTPUT);
  pinMode(RST,OUTPUT);
  
  digitalWrite(RST,LOW);  
  digitalWrite(LOAD,HIGH);
  digitalWrite(SDA,LOW);
  digitalWrite(SCK,HIGH);
  digitalWrite(RST,HIGH);
  Wire.begin();  
  Serial.begin(115200);
  delay(500);
//  nameString = "--------";

}

void loop()
{ 
  // temp read ///////////////
  int time = 0;  
  int n = 0;
/*
    while(1){
      time = millis();
      if(time % 500 == 0){
        tempRead();
        //dispLed(intTemp);
        break;
      }else{     
        //dispLed(intTemp);
      }
   }
*/
  // Disp SCE587x ////////////  
//  int k = 0;
  Clear();

/*  
  for(int k = 0; k < 16; k++){
    for(int i = 0; i < 8; i++){
      SetChar(i);
      for(int j=0;j<7;j++){
        clumnData[j] = CHAR_SET[((k * 8 + i) << 3) + j];
      }
      ColData(clumnData);

    }
*/

  char test[8];
  int a = 999;
  sprintf(test,"%d",a);
  for(int i = 0; i < 8; i++){
    DispChar(i,test[i]);
  }

  
  Serial.println(test);
  SetBrightness(6);
  delay(100);
  SetBrightness(7);
  delay(10);
 
}
// S-5851  ////////////////////////////////////////////////////
void tempRead()
{
  int data1=0;
  int data2=0;
  int data=0;
  float temp = 0;

  //Dummy Write
  Wire.beginTransmission(S5851_ADDR);
  Wire.send(0x00);
 
  //Read Data 
  ret=Wire.requestFrom(S5851_ADDR, 2);
  if (Wire.available()) {
    data1 = Wire.receive();
    data2 = Wire.receive();

    data1= data1 << 8;
    data = data1 + data2;
    data = data >> 4;
    temp = data*0.0625;

    //data = temp * 10;
     
    StoredData = data;
    intTemp = data;    
  } else {
    intTemp=999; 
  }
  ret=Wire.endTransmission();
}



// SCE5870 ////////////////////////////////////////////////////
// Software Reset
void Clear()
{
  sendData(0xC0, 0x00);
}

// Set Brightness
void SetBrightness(byte Brightness)
{
  sendData(0xE0, Brightness);
}

void DispChar(int No, char c){
  int k;
  k = (int)c;
  SetChar((byte)No);
  Serial.print(c);
  Serial.println(k);
  char uniChar[1];
      SetChar(No);
      for(int j=0;j<7;j++){
        clumnData[j] = CHAR_SET[(k << 3) + j];
      }
      ColData(clumnData);
}


// Send Char No
void SetChar(byte No)
{
  sendData(0xA0, No);
}

// Send Column Data
void ColData(byte Data[])
{
  for(int i=0;i<7;i++){
    sendData(0x00, Data[i]);  
  }
    //Serial.println("");
}

// ---------------------------------------------------
void sendData(byte OPCODE, byte DATA)
{
  digitalWrite(LOAD,LOW);
  //Send 5bit data
  for(int i=0;i<5;i++){
    digitalWrite(SCK,LOW);
    digitalWrite(SDA, (DATA >> i) & 0x01);
    digitalWrite(SCK,HIGH);
  }
  //Send OPCODE
  for(int i=5;i<8;i++){
    digitalWrite(SCK,LOW);  
    digitalWrite(SDA, (OPCODE >> i) & 0x01);
    digitalWrite(SCK,HIGH);
  }
  //Send LOAD
  digitalWrite(LOAD,HIGH);
  for(int i=0;i<3;i++){
    digitalWrite(SCK,LOW);  
    digitalWrite(SCK,HIGH);
  }
}
// -------END of CODE--------------------------------------

